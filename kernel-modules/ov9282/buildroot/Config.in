## kernel-modules/ov9282/buildroot/Config.in
```kconfig
source "$BR2_EXTERNAL_STYX_KMODS_PATH/package/styx-ov9282/Config.in"
source "$BR2_EXTERNAL_STYX_KMODS_PATH/package/styx-rp1-cfe/Config.in"
```

## kernel-modules/ov9282/buildroot/package/styx-ov9282/Config.in
```kconfig
config BR2_PACKAGE_STYX_OV9282
	bool "styx-ov9282"
	depends on BR2_LINUX_KERNEL
	help
	  Styx's build of the ov9282 sensor driver (OV9281/OV9282/OV9782):
	  the image kernel's own driver plus a 1280x480 mode centred on the
	  array, which reads 40% fewer lines than 1280x800. Installed to
	  /lib/modules/<release>/updates/, where it takes precedence over the
	  kernel's own ov9282.ko; the kernel itself is not changed. For Styx
	  images only (images using libcamera keep the stock driver).

	  The build fails when the kernel's own ov9282.c is not the one the
	  Styx driver was made from (re-import it: kernel-modules/ov9282).

comment "styx-ov9282 needs a Linux kernel to be built"
	depends on !BR2_LINUX_KERNEL
```

## kernel-modules/ov9282/buildroot/package/styx-pispbe/Config.in
```kconfig
config BR2_PACKAGE_STYX_PISPBE
	bool "styx-pispbe"
	depends on BR2_LINUX_KERNEL
	help
	  Styx's build of the PiSP back end driver (pisp_be): the image
	  kernel's own driver with a cheaper per-job config write (about
	  7 us of CPU per job instead of about 120 us). It starts every back
	  end job about 0.11 ms sooner; the hardware sees the same register
	  values. Installed to /lib/modules/<release>/updates/, where it
	  takes precedence over the kernel's own pisp-be.ko; the kernel
	  itself is not changed. For Styx images.

	  The build fails when the kernel's own pisp_be sources are not the
	  ones the Styx driver was made from (re-import them:
	  kernel-modules/pispbe).

comment "styx-pispbe needs a Linux kernel to be built"
	depends on !BR2_LINUX_KERNEL
```

## kernel-modules/rp1-cfe/buildroot/package/styx-rp1-cfe/Config.in
```kconfig
config BR2_PACKAGE_STYX_RP1_CFE
	bool "styx-rp1-cfe"
	depends on BR2_LINUX_KERNEL
	help
	  Styx's build of the Raspberry Pi 5 / CM5 camera receiver driver
	  (rp1-cfe-downstream): the image kernel's own driver plus a
	  mid-frame line event, which lets Styx process a frame in slices
	  during readout. Installed to /lib/modules/<release>/updates/,
	  where it takes precedence over the kernel's own
	  rp1-cfe-downstream.ko; the kernel itself is not changed. For Styx
	  images only (images using libcamera keep the stock driver).

	  The build fails when the kernel's own rp1_cfe sources are not the
	  ones the Styx driver was made from (re-import them:
	  kernel-modules/rp1-cfe).

comment "styx-rp1-cfe needs a Linux kernel to be built"
	depends on !BR2_LINUX_KERNEL
```

## kernel-modules/styx-sensor-bridge/Kconfig
```kconfig
# SPDX-License-Identifier: GPL-2.0
config VIDEO_STYX_SENSOR_BRIDGE
	tristate "Styx sensor bridge (camera sensor driven from userspace)"
	depends on OF && I2C && VIDEO_DEV
	select MEDIA_CONTROLLER
	select VIDEO_V4L2_SUBDEV_API
	select V4L2_FWNODE
	help
	  A generic V4L2 sensor subdevice for camera sensors that are driven
	  from userspace over i2c-dev (Styx). It describes the CSI-2 link to
	  the receiver and forwards stream start/stop to userspace.

	  To compile this driver as a module, choose M here: the module will
	  be called styx_sensor_bridge.
```
